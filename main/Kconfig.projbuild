## main/Kconfig.projbuild
```kconfig
menu "GPS NTP Server"

    config GPSNTP_PPS_PIN
        int "GPS PPS GPIO number"
        default 35
        help
            GPIO that has GPS PPS signal connected

    config GPSNTP_SQW_PIN
        int "RTC SQW GPIO number"
        default 26
        help
            GPIO that has RTC SQW signal connected

    config GPSNTP_MISS_TIME
        int "Max PPS pulse interval"
        default 1000050
        help
            Maximum time in microseconds for PPS pulse

    config GPSNTP_SHORT_TIME
        int "Min PPS pulse interval"
        default 999950
        help
            Minimum time in microseconds for PPS pulse

    config GPSNTP_RTC_DRIFT_MAX
        int "Maximum drift for RTC pulse"
        default 500
        help
            Maximum drift for RTC pulse

    choice GPSNTP_GPS_TYPE

        prompt "Select GPS type"
        default GPSNTP_GPS_TYPE_GENERIC
        help
            Select the GPS module type.

        config GPSNTP_GPS_TYPE_GENERIC
            bool "GPS type is GENERIC"

        config GPSNTP_GPS_TYPE_UBLOX6M
            bool "GPS type is UBLOX 6M"

        config GPSNTP_GPS_TYPE_SKYTRAQ
            bool "GPS type is SKYTRAQ"

        config GPSNTP_GPS_TYPE_MTK3339
            bool "GPS type is MTK3339 (Adafruit Untimate GPS)"

    endchoice

    config GPSNTP_ENABLE_115220BAUD
        depends on !GPSNTP_GPS_TYPE_GENERIC
        bool "Enable 115200 baud"
        default n

endmenu
```

## src/Kconfig.projbuild
```kconfig
menu "GPS NTP Server"

    config GPSNTP_MISS_TIME
        int "Max PPS pulse interval"
        default 1000050
        help
            Maximum time in microseconds for PPS pulse

    config GPSNTP_SHORT_TIME
        int "Min PPS pulse interval"
        default 999950
        help
            Minimum time in microseconds for PPS pulse

    config GPSNTP_RTC_DRIFT_MAX
        int "Maximum drift for RTC pulse"
        default 500
        help
            Maximum drift for RTC pulse

    config GPSNTP_RTC_DRIFT_MIN
        int "Minimum drift for RTC pulse"
        default 999500
        help
            Minimum drift for RTC pulse

    choice GPSNTP_MICROSECOND_TIMER_GROUP
        prompt "Select timergroup for microsecond timer"
        default GPSNTP_MICROSECOND_TIMER_GROUP_0

        config GPSNTP_MICROSECOND_TIMER_GROUP_0
            bool "Timer Group 0"

        config GPSNTP_MICROSECOND_TIMER_GROUP_1
            bool "Timer Group 1"
    endchoice

    choice GPSNTP_MICROSECOND_TIMER
        prompt "Select timer for microsecond timer"
        default GPSNTP_MICROSECOND_TIMER_0

        config GPSNTP_MICROSECOND_TIMER_0
            bool "Timer 0"

        config GPSNTP_MICROSECOND_TIMER_1
            bool "Timer 1"
    endchoice

    choice GPSNTP_GPS_TYPE

        prompt "Select GPS type"
        default GPSNTP_GPS_TYPE_GENERIC
        help
            Select the GPS module type.

        config GPSNTP_GPS_TYPE_GENERIC
            bool "GPS type is GENERIC"

        config GPSNTP_GPS_TYPE_UBLOX6M
            bool "GPS type is UBLOX 6M"

        config GPSNTP_GPS_TYPE_SKYTRAQ
            bool "GPS type is SKYTRAQ"

        config GPSNTP_GPS_TYPE_MTK3339
            bool "GPS type is MTK3339 (Adafruit Untimate GPS)"

    endchoice

    config GPSNTP_ENABLE_115220BAUD
        depends on !GPSNTP_GPS_TYPE_GENERIC
        bool "Enable 115200 baud"
        default n

endmenu
```
